## components/telegram_client/Kconfig.projbuild
```kconfig
menu "App Telegram Configuration"
config APP_TELEGRAM_BOT_TOKEN
    string "Telegram bot token"
    default "MyBotToken"
endmenu
```

## components/wifi_handler/Kconfig.projbuild
```kconfig
menu "App Wi-Fi Configuraton"
config APP_WIFI_SSID
    string "Wi-Fi SSID"
    default "MySSID"

config APP_WIFI_PASS
    string "Wi-Fi Password"
    default "MyPassword"
endmenu
```

## sdkconfig.defaults
```kconfig
CONFIG_ESPTOOLPY_FLASHFREQ_80M=y
CONFIG_ESPTOOLPY_FLASHFREQ="80m"

CONFIG_ESP_DEFAULT_CPU_FREQ_MHZ_240=y
CONFIG_ESP_DEFAULT_CPU_FREQ_MHZ=240
CONFIG_ESP32_DEFAULT_CPU_FREQ_240=y
CONFIG_ESP32_DEFAULT_CPU_FREQ_MHZ=240

CONFIG_LOG_MAXIMUM_LEVEL_VERBOSE=y
CONFIG_LOG_MAXIMUM_LEVEL=5
CONFIG_LOG_DEFAULT_LEVEL_INFO=y
CONFIG_LOG_DEFAULT_LEVEL=3
```
