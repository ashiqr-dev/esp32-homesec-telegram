## main/KConfig.projbuild
```kconfig
menu "Project configuration"
    config ESP_WIFI_SSID
        string "Wi-Fi SSID"
        default "myssid"
        help
            Wi-Fi network name to connect to.
    
    config ESP_WIFI_PASS
        string "Wi-Fi Password"
        default "mypass"
        help
            Wi-Fi password to use.

    config ESP_TELEGRAM_BOT_TOKEN
        string "Telegram bot token"
        default "mytoken"
        help
            Telegram bot token for the bot to use.

    config ESP_TELEGRAM_CHAT_ID
        string "Telegram chat ID"
        default "123456"
        help
            Telegram chat ID for the bot to send messages to.
endmenu
```

## main/Kconfig.projbuild
```kconfig
menu "Wi-Fi Configuration"
    config ESP_WIFI_SSID
        string "Wi-Fi SSID"
        default "myssid"
        help
            SSID (network name) for the firmware to connect to.

    config ESP_WIFI_PASSWORD
        string "Wi-Fi Password"
        default "mypassword"
        help
            Wi-Fi password (WPA or WPA2) for the firmware to use.
endmenu
```
